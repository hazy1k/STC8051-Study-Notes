/**************************************************************************************
深圳市普中科技有限公司（PRECHIN 普中）
技术支持：www.prechin.net

实验名称：LED点阵实验(显示数字)
接线说明：	
实验现象：下载程序后，16*16LED点阵显示数字0
注意事项：																				  
***************************************************************************************/
#include "reg51.h"
#include "intrins.h"

typedef unsigned int u16;	//对系统默认数据类型进行重定义
typedef unsigned char u8;

//定义74HC595控制管脚
sbit SRCLK=P3^6;	//移位寄存器时钟输入
sbit RCLK=P3^5;		//存储寄存器时钟输入
sbit SER=P3^4; 		//串行数据输入


//LED点阵显示数字0的列数据
u8 gled_col[32]=
{0x00,0x00,0xE0,0x03,0x10,0x04,0x08,0x08,0x04,0x10,0x04,0x10,0x04,0x10,0x04,0x10,
0x04,0x10,0x04,0x10,0x04,0x10,0x04,0x10,0x08,0x08,0x10,0x04,0xE0,0x03,0x00,0x00};
//LED点阵显示数字0的行数据
u8 gled_row[32]=
{0x01,0x02,0x04,0x08,0x10,0x20,0x40,0x80,0x00,0x00,0x00,0x00,0x00,0x00,0x00,0x00,
0x00,0x00,0x00,0x00,0x00,0x00,0x00,0x00,0x01,0x02,0x04,0x08,0x10,0x20,0x40,0x80};

/*******************************************************************************
* 函 数 名       : delay_10us
* 函数功能		 : 延时函数，ten_us=1时，大约延时10us
* 输    入       : ten_us
* 输    出    	 : 无
*******************************************************************************/
void delay_10us(u16 ten_us)
{
	while(ten_us--);	
}

/*******************************************************************************
* 函 数 名         : hc595_write_data(u8 dat)
* 函数功能		   : 向74HC595写入4个字节的数据
* 输    入         : dat1：对应74HC595(A)输出第1行-第8行
					 dat2：对应74HC595(B)输出第9行-第16行
					 dat3：对应74HC595(C)输出第1列-第8列
					 dat4：对应74HC595(D)输出第9列-第16列
* 输    出         : 无
*******************************************************************************/
void hc595_write_data(u8 dat1,u8 dat2,u8 dat3,u8 dat4)
{
	u8 i=0;
	
	for(i=0;i<8;i++)//循环8次即可将一个字节写入寄存器中
	{
		SER=dat4>>7;//优先传输一个字节中的高位
		dat4<<=1;//将低位移动到高位
		SRCLK=0;
//		delay_10us(1);
		_nop_();
		SRCLK=1;
		_nop_();
//		delay_10us(1);//移位寄存器时钟上升沿将端口数据送入寄存器中	
	}
	
	for(i=0;i<8;i++)
	{
		SER=dat3>>7;
		dat3<<=1;
		SRCLK=0;
//		delay_10us(1);
		_nop_();
		SRCLK=1;
		_nop_();
//		delay_10us(1);//移位寄存器时钟上升沿将端口数据送入寄存器中	
	}

	for(i=0;i<8;i++)
	{
		SER=dat2>>7;
		dat2<<=1;
		SRCLK=0;
//		delay_10us(1);
		_nop_();
		SRCLK=1;
		_nop_();
//		delay_10us(1);//移位寄存器时钟上升沿将端口数据送入寄存器中	
	}

	for(i=0;i<8;i++)
	{
		SER=dat1>>7;
		dat1<<=1;
		SRCLK=0;
//		delay_10us(1);
		_nop_();
		SRCLK=1;
		_nop_();
//		delay_10us(1);//移位寄存器时钟上升沿将端口数据送入寄存器中	
	}

	RCLK=1;
	delay_10us(1);
	RCLK=0;//存储寄存器时钟上升沿将前面写入到寄存器的数据输出	
}


/*******************************************************************************
* 函 数 名       : main
* 函数功能		 : 主函数
* 输    入       : 无
* 输    出    	 : 无
*******************************************************************************/
void main()
{	
	u8 i=0;

	while(1)
	{			
		for(i=0;i<16;i++)//循环16次扫描16行、列
		{
			hc595_write_data(gled_row[i],gled_row[i+16],~gled_col[i*2],~gled_col[i*2+1]);//传送行列选数据
			delay_10us(10);//延时一段时间，等待显示稳定
			hc595_write_data(0x00,0x00,0x00,0x00);//消影	
		}								
	}		
}