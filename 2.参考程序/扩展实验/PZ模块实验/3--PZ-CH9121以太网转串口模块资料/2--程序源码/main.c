/**************************************************************************************
深圳市普中科技有限公司（PRECHIN 普中）
技术支持：www.prechin.net
PRECHIN
 普中																				  
***************************************************************************************/

#include "reg52.h"			 //此文件中定义了单片机的一些特殊功能寄存器
#include <string.h>

typedef unsigned int u16;	  //对数据类型进行声明定义
typedef unsigned char u8;

sbit LED1=P2^0;
sbit LED2=P2^1;

#define USART3_REC_LEN  			50  	//定义最大接收字节数 100
u8 USART3_RX_BUF[USART3_REC_LEN];     //接收缓冲
//通过判断接收连续2个字符之间的时间差不大于10ms来决定是不是一次连续的数据.
//如果2个字符接收间隔超过10ms,则认为不是1次连续数据.也就是超过10ms没有接收到
//任何数据,则表示此次接收完毕.
//接收到的数据状态
//[15]:0,没有接收到数据;1,接收到了一批数据.
//[14:0]:接收到的数据长度
u16 USART3_RX_STA=0;       //接收状态标记	


void CH9121_SendString(u8 *buf);

void delay(u16 i)
{
	while(i--);
}

/*******************************************************************************
* 函 数 名         : Timer0Init
* 函数功能		   : 定时器0初始化
* 输    入         : 无
* 输    出         : 无
*******************************************************************************/
void Timer0Init()
{
	TMOD|=0X01;//选择为定时器0模式，工作方式1，仅用TR0打开启动。

	TH0=0XDC;	//给定时器赋初值，定时10ms
	TL0=0X00;	
	ET0=1;//打开定时器0中断允许
	EA=1;//打开总中断			
}

/*******************************************************************************
* 函数名         :UsartInit()
* 函数功能		   :设置串口
* 输入           : 无
* 输出         	 : 无
*******************************************************************************/
void CH9121_Init()
{
	SCON=0X50;			//设置为工作方式1
	TMOD=0X20;			//设置计数器工作方式2
	PCON=0X80;			//波特率加倍
	TH1=0XFA;				//计数器初始值设置，注意波特率是9600的
	TL1=0XFA;
	ES=1;						//打开接收中断
	EA=1;						//打开总中断
	TR1=1;					//打开计数器

	Timer0Init();		//10ms中断
	USART3_RX_STA=0;		//清零
	TR0=0;//关闭定时器0
}



/*******************************************************************************
* 函 数 名       : main
* 函数功能		 : 主函数
* 输    入       : 无
* 输    出    	 : 无
*******************************************************************************/
void main()
{	
	u8 i=0; 
	u8 reclen=0;

	CH9121_Init();  //串口初始化
	while(1)
	{
		if(USART3_RX_STA&0X8000)//接收到一次数据
		{
			reclen=USART3_RX_STA&0X7FFF;	//得到数据长度
		  	USART3_RX_BUF[reclen]='\0';	 	//加入结束符
//			printf("reclen=%d\r\n",reclen);
//			printf("USART3_RX_BUF=%s\r\n",USART3_RX_BUF);
//			CH9121_SendString(USART3_RX_BUF);
			USART3_RX_STA=0;
		}
		
		if(strcmp((char *)USART3_RX_BUF,"LED_ON")==0)
			LED2=0;
		else if(strcmp((char *)USART3_RX_BUF,"LED_OFF")==0)
			LED2=1;


		i++;
		if(i%50==0)
		{
			LED1=!LED1;
			CH9121_SendString("Hello PRECHIN-51\r\n");
		}
		delay(1000);
	}		
}

/*******************************************************************************
* 函数名         : Usart() interrupt 4
* 函数功能		  : 串口通信中断函数
* 输入           : 无
* 输出         	 : 无
*******************************************************************************/
void Usart() interrupt 4
{
	u8 r;
	
	if(RI)
	{
		r=SBUF;//读取接收到的数据
		if((USART3_RX_STA&(1<<15))==0)//接收完的一批数据,还没有被处理,则不再接收其他数据
		{
			if(USART3_RX_STA<USART3_REC_LEN)	//还可以接收数据
			{
				TH0=0XDC;	//给定时器赋初值，定时10ms
				TL0=0X00; 
				if(USART3_RX_STA==0) 				//使能定时器7的中断 
				{
					TR0=1;//打开定时器0
				}
				USART3_RX_BUF[USART3_RX_STA++]=r;	//记录接收到的值
			}
			else 
			{
				USART3_RX_STA|=1<<15;				//强制标记接收完成
			} 
		}  		
	}
	RI = 0;//清除接收中断标志位	
}

void CH9121_SendString(u8 *buf)
{
	while(*buf!='\0') //遇到结束符跳出循环	
	{
		SBUF=*buf;//将接收到的数据放入到发送寄存器
		while(!TI);	//等待发送数据完成
		TI=0;		//清除发送完成标志位
		buf++;	
	}
}

/*******************************************************************************
* 函 数 名         : void Timer0() interrupt 1
* 函数功能		   : 定时器0中断函数
* 输    入         : 无
* 输    出         : 无
*******************************************************************************/
void Timer0() interrupt 1
{
	TH0=0XDC;	//给定时器赋初值，定时10ms
	TL0=0X00;
	USART3_RX_STA|=1<<15;	//标记接收完成
	TR0=0;//关闭定时器0	
}