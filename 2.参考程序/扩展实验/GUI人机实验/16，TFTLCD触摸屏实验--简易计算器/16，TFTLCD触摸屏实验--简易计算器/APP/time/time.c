#include "time.h"

sbit LED1=P3^1;

u8 t_sec=10;
u8 t_min=31;
u8 t_hour=10;
u8 t_secflag=0;

/*******************************************************************************
* 函 数 名         : Timer0Init
* 函数功能		   : 定时器0初始化
* 输    入         : 无
* 输    出         : 无
*******************************************************************************/
void Timer0Init(void)
{
	TMOD|=0X01;//选择为定时器0模式，工作方式1，仅用TR0打开启动。

	TH0=0X3C;	//给定时器赋初值，定时50ms
	TL0=0XB0;	
	ET0=1;//打开定时器0中断允许
	EA=1;//打开总中断
	TR0=1;//打开定时器			
}

/*******************************************************************************
* 函 数 名         : void Timer0() interrupt 1
* 函数功能		   : 定时器0中断函数
* 输    入         : 无
* 输    出         : 无
*******************************************************************************/
void Timer0() interrupt 1
{
	static u8 i;
	TH0=0X3C;	//给定时器赋初值，定时50ms
	TL0=0XB0;
	i++;
	if(i==20)//定时器到达1s
	{
		i=0;
		t_secflag=1;
		t_sec++;
		LED1=!LED1;
		if(t_sec==60)
		{
			t_sec=0;
			t_min++;
			if(t_min==60)
			{
				t_min=0;
				t_hour++;
				if(t_hour==24)t_hour=0;
			}
		}	
	}	
}

