/*------------------------------------------------------------------*/
/* --- STC MCU International Limited -------------------------------*/
/* --- STC IAP 系列单片机实现用户ISP 演示程序 ----------------------*/
/* --- Mobile: (86)13922805190 -------------------------------------*/
/* --- Fax: 86-755-82944243 ----------------------------------------*/
/* --- Tel: 86-755-82948412 ----------------------------------------*/
/* --- Web: www.STCMCU.com -----------------------------------------*/
/* 如果要在程序中使用或者在文章中引用该程序,请在程序中或文章中注明  */
/* 使用了宏晶科技的资料或程序                                       */
/*------------------------------------------------------------------*/

#include "reg51.h"

#define FOSC 22118400L                  //系统时钟频率
#define BAUD (256 - FOSC/32/115200)     //定义串口波特率		要与IAP里的相同


/* 定义串口相关SFR */
sfr AUXR = 0x8E;                        //波特率发生器控制寄存器
sfr ISP_CONTR = 0xC7;
sfr PCON2     = 0x97;   //for IAP15F2K61S2
sfr P_SW1     = 0xA2;   //for IAP15F2K61S2

char HandCnt;                             //Isp_Check内部使用的变量

void uart() interrupt 4         //串口中断服务程序
{
    if (TI) TI = 0;                     //发送完成中断
    if (RI)                             //接收完成中断
    {
        if (SBUF == 'd')
        {
            HandCnt++;
            if (HandCnt >= 16)
            {
                ISP_CONTR = 0x20;           //复位到AP入口
            }
        }
        else	HandCnt = 0;
        RI = 0;                         //清接收完成标志
    }
}

void main()
{
    SCON = 0x50;                        //定义串口模式为8bit可变,无校验位
    AUXR = 0x40;                        //波特率发生器12倍速,并启动波特率发生器定时器
    TMOD = 0x20;                         //初始化波特率发生器定时器的定时初值

//对于IAP15F2K61S2, 增加这两句,串口1可以切换P30,P31
   	P_SW1 &= ~0xc0;		//S1_USE_P30P31();
	PCON2 &= ~(1<<4);	//S1_TXD_RXD_OPEN();

    TH1 = BAUD;
	TR1 = 1;
	ES = 1;                             //使能串口中断
    EA = 1;                             //打开全局中断开关

    while (1)
    {
        P1++;
    }
}
